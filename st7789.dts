/dts-v1/;
/plugin/;

/ {
        compatible = "brcm,bcm2835";

        // Enable the SPI controller
        fragment@0 {
                target = <&spi0>;
                __overlay__ {
                        status = "okay";
                };
        };

        // Enabling the SPI controller also enables spidev on cs0, so we have disable it
        fragment@1 {
                target = <&spidev0>;
                __overlay__ {
                        status = "disabled";
                };
        };

        fragment@2 {
                target = <&spi0>;
                __overlay__ {
                        /* needed to avoid dtc warning */
                        #address-cells = <1>;
                        #size-cells = <0>;

                        display: display@0{

                                compatible = "sitronix,st7789v";
                //compatible = "sitronix,st7735r";
                                reg = <0>; // Chip Select 0

                                spi-max-frequency = <40000000>; // 40MHz

                                reset-gpios = <&gpio 25 1>; // reset is active low hence the 1
                                dc-gpios = <&gpio 17 0>;
                                led-gpios = <&gpio 24 0>;

                                // mode3 = (cpol | cpha)
                                spi-cpol;
                                spi-cpha;


                                width = <240>;
                                height = <240>;
                                buswidth = <8>; // Most controllers use this value

                                // This is a hack to prevent fb_s6d02a1.c:set_var() from issuing
                                // command 0x36 after the init sequence has been applied and thus
                                // changing the config.
                                //rotate = <1>;

                                // see drivers/staging/fbtft/fb_ili9341.c:init_display() for how this looks in the driver
                                // Command 0x36 is taken from the fb_ili9341.c:set_var() function.
                                init = <0x1000001
                        0x2000096
                        0x1000036 0x70
                        0x10000b2 0x0c 0x0c 0x00 0x33 0x33
                        0x100003a 0x05
                        0x10000b7 0x14
                        0x10000bb 0x37
                        0x10000c0 0x2c
                        0x10000c2 0x01
                        0x10000c3 0x12
                        0x10000c4 0x20
                        0x10000d0 0xa4 0xa1
                        0x10000c6 0x0f
                        0x10000e0 0xd0 0x04 0x0d 0x11 0x13 0x2b 0x3f 0x54 0x4c 0x18 0x0d 0x0b 0x1f 0x23
                        0x10000e1 0xd0 0x04 0x0c 0x11 0x13 0x2c 0x3f 0x44 0x51 0x2f 0x1f 0x1f 0x20 0x23
                        0x1000021
                        0x1000011
                        0x1000029
                        0x2000064>;

                                debug = <0x4000000>; // print init commands to the kernel log
                        };
                };
        };
};
